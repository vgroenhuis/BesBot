## esp-idf/main/Kconfig.projbuild
```kconfig
menu "BesBot"
    config BESBOT_IN1_GPIO
        int "GPIO to L298N IN1 (left motor, forward)"
        default 9
    config BESBOT_IN2_GPIO
        int "GPIO to L298N IN2 (left motor, backward)"
        default 10
    config BESBOT_IN3_GPIO
        int "GPIO to L298N IN3 (right motor, forward)"
        default 25
    config BESBOT_IN4_GPIO
        int "GPIO to L298N IN4 (right motor, backward)"
        default 26
    config BESBOT_ENC_LEFT_A_GPIO
        int "GPIO to the left motor's encoder A"
        default 6
    config BESBOT_ENC_LEFT_B_GPIO
        int "GPIO to the left motor's encoder B"
        default 7
    config BESBOT_ENC_RIGHT_A_GPIO
        int "GPIO to the right motor's encoder A"
        default 24
    config BESBOT_ENC_RIGHT_B_GPIO
        int "GPIO to the right motor's encoder B"
        default 23
    config BESBOT_MAX_PCT
        int "Default top speed in percent (changeable on the page)"
        default 100
        range 10 100
    config BESBOT_LED_GPIO
        int "GPIO of the on-board RGB LED"
        default 27
        help
            The Waveshare ESP32-C5 board (like the ESP32-C5-DevKitC-1) has its addressable RGB LED (WS2812) on GPIO27.
    config BESBOT_LED_SWAP_RG
        bool "The LED's red and green are swapped (Waveshare ESP32-C5 boards)"
        default y
    config BESBOT_OLED_SDA_GPIO
        int "GPIO to the OLED display's SDA (-1: no display)"
        default 3
    config BESBOT_OLED_SCL_GPIO
        int "GPIO to the OLED display's SCL"
        default 2
    config BESBOT_OLED_SH1106
        bool "The display has an SH1106 controller (most 1.3\" ones) instead of an SSD1306 (0.96\")"
        default n
    config BESBOT_OLED_FLIP
        bool "The display is mounted upside down"
        default n
    config BESBOT_BRIGHTNESS
        int "LED brightness in percent"
        default 25
        range 1 100
endmenu
```
